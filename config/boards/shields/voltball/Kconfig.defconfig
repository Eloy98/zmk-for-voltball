## config/boards/shields/voltball/Kconfig.defconfig
```kconfig
if SHIELD_VOLTBALL_RIGHT

config ZMK_KEYBOARD_NAME
    default "Voltball"

config ZMK_BLE
    default y

config ZMK_SPLIT_ROLE_CENTRAL
    default y

config INPUT
    default y

config ZMK_POINTING
    default y

config PAW3222
    default y
    
endif

if SHIELD_VOLTBALL_LEFT || SHIELD_VOLTBALL_RIGHT

config ZMK_SPLIT
    default y

config ZMK_STATUS_LED
    default y

config INPUT
    default y

config SPI
    default y    


endif
```

## config/boards/shields/voltball/Kconfig.shield
```kconfig
config SHIELD_VOLTBALL_LEFT
    def_bool $(shields_list_contains,voltball_left)

config SHIELD_VOLTBALL_RIGHT
    def_bool $(shields_list_contains,voltball_right)
```

## config/west.yml
```yaml
manifest:
  remotes:
    - name: zmkfirmware
      url-base: https://github.com/zmkfirmware
    - name: sekigon-gonnoc
      url-base: https://github.com/sekigon-gonnoc
  projects:
    - name: zmk
      remote: zmkfirmware
      revision: v0.3
      import: app/west.yml
    - name: zmk-feature-status-led
      remote: sekigon-gonnoc
      revision: main
  self:
    path: config
```
